## config/west.yml
```yaml
manifest:
  remotes:
    - name: zmkfirmware
      url-base: https://github.com/zmkfirmware
    - name: hitsmaxft
      url-base: https://github.com/hitsmaxft
  projects:
    - name: zmk
      remote: zmkfirmware
      revision: 4de313367288aad5aeaa1243890e40dc813f7008
      import: app/west.yml
    - name: zmk-keyboard-cornix
      remote: hitsmaxft
      revision: v3.0.1
  self:
    path: config
```
